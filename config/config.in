## config/config.in
```kconfig
# crosstool-NG framework
source "config/configure.in"
source "config/backend.in"
source "config/global.in"
source "config/toolchain.in"

# lnp-forge specific
source "config/df.in"
source "config/lnp.in"
source "config/embark.in"
source "config/keybinds.in"
source "config/dfhack.in"
source "config/graphics.in"
source "config/therapist.in"
source "config/soundsense.in"
source "config/legends.in"
source "config/announcement.in"
```
